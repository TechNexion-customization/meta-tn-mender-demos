## conf/layer.conf
```bitbake
# We have a conf directory, add to BBPATH
BBPATH .= ":${LAYERDIR}"

# We have recipes-* directories, add to BBFILES
BBFILES += "${LAYERDIR}/recipes-*/*/*.bb \
	${LAYERDIR}/recipes-*/*/*.bbappend"

BBFILE_COLLECTIONS += "meta-tn-mender-demos"
BBFILE_PATTERN_meta-tn-mender-demos = "^${LAYERDIR}/"
BBFILE_PRIORITY_meta-tn-mender-demos = "10"

LAYERSERIES_COMPAT_meta-tn-mender-demos = "sumo thud warrior zeus"

LAYERDEPENDS_meta-tn-mender-demos = "meta-tn-imx-bsp mender"
```
